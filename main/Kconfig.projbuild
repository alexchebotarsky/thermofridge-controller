## main/Kconfig.projbuild
```kconfig
menu "Environment Variables"

config DEVICE_ID
    string "Device ID"
    default ""

config WIFI_SSID
    string "WiFi SSID"
    default ""

config WIFI_PASSWORD
    string "WiFi Password"
    default ""

config MQTT_BROKER_URL
    string "MQTT Broker URL"
    default "mqtt://localhost"

config MQTT_CLIENT_ID
    string "MQTT Client ID"
    default "thermofridge-controller"

config MQTT_QOS
    int "MQTT Quality of Service (QoS)"
    range 0 2
    default 1
    help
        0 - At most once
        1 - At least once
        2 - Exactly once

config MQTT_RETENTION_POLICY
    int "MQTT Retention Policy"
    range 0 1
    default 0
    help
        0 - no retention
        1 - retain last message

config MQTT_CURRENT_STATE_TOPIC
    string "MQTT Current State Topic"
    default "thermostat/current-state"
    help
        MQTT topic to publish current state to.

config MQTT_TARGET_STATE_TOPIC
    string "MQTT Target State Topic"
    default "thermostat/set/target-state"
    help
        MQTT topic to subscribe to and listen for target state changes.

config TEMPERATURE_SENSOR_GPIO
    int "Temperature Sensor GPIO Pin"
    default 4

config FRIDGE_RELAY_GPIO
    int "Fridge Relay GPIO Pin"
    default 18

config HEATER_RELAY_GPIO
    int "Heater Relay GPIO Pin"
    default 19

config DEFAULT_MODE
    string "Default Mode"
    default "OFF"

config DEFAULT_TARGET_TEMPERATURE
    int "Default Target Temperature"
    default 20

config TEMPERATURE_CHECK_INTERVAL_MS
    int "Temperature Check Interval (ms)"
    default 30000
    help
        Interval for how often the controller checks the current temperature
        against the target temperature.

endmenu
```
